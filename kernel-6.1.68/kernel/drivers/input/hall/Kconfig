## kernel-6.1.68/kernel/drivers/input/hall/Kconfig
```kconfig
#
# Mediatek Hall Driver
#

config HQ_PEN_HALL
	tristate "hall mode detect interrupt pin register an input device"
	default n
	help
	  To support register an input device in hall model detect function.
	  if yes, then it is supported,
	  if no, it is disabled.
	  The option default enabled.
```

## kernel/lenovo/kirby/kernel/arch/arm64/configs/kirby_defconfig
```kconfig
CONFIG_ARCH_CLIFFS=y
CONFIG_ARCH_PINEAPPLE=y
CONFIG_ARCH_VOLCANO=y
CONFIG_ARM_QCOM_CPUFREQ_HW=n
CONFIG_ARM_QCOM_CPUFREQ_HW_DEBUG=n
# CONFIG_ARM_QCOM_CPUFREQ_NVMEM is not set
CONFIG_ARM_SMMU=n
CONFIG_ARM_SMMU_DISABLE_BYPASS_BY_DEFAULT=y
CONFIG_ARM_SMMU_QCOM=n
CONFIG_BACKLIGHT_QCOM_SPMI_WLED=n
CONFIG_CFG80211=n
# CONFIG_CFG80211_CRDA_SUPPORT is not set
# CONFIG_CHARGER_QCOM_SMBB is not set
CONFIG_CHR_DEV_SG=n
CONFIG_COMMON_CLK_QCOM=n
CONFIG_CORESIGHT=n
CONFIG_CORESIGHT_CSR=n
CONFIG_CORESIGHT_CTI=n
CONFIG_CORESIGHT_DUMMY=n
CONFIG_CORESIGHT_HWEVENT=n
CONFIG_CORESIGHT_LINKS_AND_SINKS=n
CONFIG_CORESIGHT_LINK_AND_SINK_TMC=n
CONFIG_CORESIGHT_REMOTE_ETM=n
CONFIG_CORESIGHT_STM=n
CONFIG_CORESIGHT_TGU=n
CONFIG_CORESIGHT_TPDA=n
CONFIG_CORESIGHT_TPDM=n
CONFIG_CORESIGHT_TRACE_NOC=n
CONFIG_CPU_IDLE_GOV_QCOM_LPM=n
CONFIG_CRC_ITU_T=n
CONFIG_QTI_THERMALZONE_CONFIG_DEBUG=n
CONFIG_DRM_DISPLAY_DP_HELPER=y
CONFIG_DRM_DISPLAY_HELPER=n
CONFIG_DRM_DP_AUX_BUS=n
CONFIG_DRM_LT9611UXC=n
CONFIG_DRM_MSM_HELPER=n
CONFIG_EDAC_QCOM=n
CONFIG_EDAC_QCOM_LLCC_PANIC_ON_UE=y
CONFIG_GH_ARM64_DRV=n
CONFIG_GH_CPUSYS_VM_MEM_ACCESS=n
CONFIG_GH_CTRL=n
CONFIG_GH_DBL=n
# CONFIG_GH_GUEST_POPS is not set
CONFIG_GH_IRQ_LEND=n
CONFIG_GH_MEM_NOTIFIER=n
CONFIG_GH_MSGQ=n
CONFIG_GH_PANIC_NOTIFIER=n
CONFIG_GH_PROXY_SCHED=n
CONFIG_GH_RM_BOOSTER=n
CONFIG_GH_RM_DRV=n
CONFIG_GH_SECURE_VM_LOADER=n
CONFIG_GH_TLMM_VM_MEM_ACCESS=n
CONFIG_GH_VIRT_WATCHDOG=n
CONFIG_GIC_INTERRUPT_ROUTING=n
CONFIG_GUNYAH_DRIVERS=y
CONFIG_GUNYAH_QCOM_PLATFORM=n
CONFIG_HVC_GUNYAH=n
# CONFIG_HVC_GUNYAH_CONSOLE is not set
CONFIG_HWMON=n
CONFIG_HWSPINLOCK_QCOM=n
CONFIG_I2C_MSM_GENI=n
CONFIG_I3C_MASTER_MSM_GENI=n
CONFIG_INPUT_PM8941_PWRKEY=n
# CONFIG_INPUT_PM8XXX_VIBRATOR is not set
CONFIG_INTERCONNECT_QCOM_CLIFFS=n
CONFIG_INTERCONNECT_QCOM_DEBUG=n
CONFIG_INTERCONNECT_QCOM_PINEAPPLE=n
CONFIG_INTERCONNECT_QCOM_VOLCANO=n
CONFIG_INTERCONNECT_TEST=n
CONFIG_IOMMU_IO_PGTABLE_FAST=y
CONFIG_IPA3=n
CONFIG_IPC_LOGGING=n
CONFIG_IPC_LOG_MINIDUMP_BUFFERS=16
CONFIG_LEDS_QPNP_VIBRATOR_LDO=n
CONFIG_LEDS_QTI_FLASH=n
CONFIG_LEDS_QTI_TRI_LED=n
CONFIG_MAC80211=n
CONFIG_MAX31760_FAN_CONTROLLER=n
CONFIG_MEM_SHARE_QMI_SERVICE=n
CONFIG_MFD_I2C_PMIC=n
CONFIG_MFD_SPMI_PMIC=n
CONFIG_MHI_BUS=n
CONFIG_MHI_BUS_MISC=y
CONFIG_MHI_SATELLITE=n
CONFIG_MHI_UCI=n
# CONFIG_MINIDUMP_ALL_TASK_INFO is not set
CONFIG_MINIDUMP_MAX_ENTRIES=200
CONFIG_MMC_SDHCI_MSM=n
# CONFIG_MODULE_SIG_ALL is not set
CONFIG_MSM_BOOT_STATS=n
CONFIG_MSM_CORE_HANG_DETECT=n
CONFIG_MSM_GPI_DMA=n
# CONFIG_MSM_GPI_DMA_DEBUG is not set
CONFIG_MSM_PERFORMANCE=n
CONFIG_MSM_QMP=n
CONFIG_MSM_RDBG=n
CONFIG_MSM_SYSSTATS=n
CONFIG_MSM_SYSSTATS_STUB_NONEXPORTED_SYMBOLS=y
CONFIG_MSM_SYSTEM_HEALTH_MONITOR=n
CONFIG_MSM_TMECOM_QMP=n
# CONFIG_NITRO_ENCLAVES is not set
CONFIG_NL80211_TESTMODE=y
CONFIG_NOP_USB_XCEIV=n
CONFIG_NVMEM_QCOM_QFPROM=n
CONFIG_NVMEM_SPMI_SDAM=n
CONFIG_PCI_MSM=n
CONFIG_PDR_INDICATION_NOTIF_TIMEOUT=9000
CONFIG_PHY_QCOM_UFS=n
CONFIG_PHY_QCOM_UFS_QRBTC_SDM845=n
CONFIG_PHY_QCOM_UFS_V4=n
CONFIG_PHY_QCOM_UFS_V4_CROW=n
CONFIG_PHY_QCOM_UFS_V4_PINEAPPLE=n
CONFIG_PINCTRL_CLIFFS=n
CONFIG_PINCTRL_MSM=n
CONFIG_PINCTRL_PINEAPPLE=n
CONFIG_PINCTRL_QCOM_SPMI_PMIC=n
CONFIG_PINCTRL_VOLCANO=n
# CONFIG_PM8916_WATCHDOG is not set
CONFIG_POWER_RESET_QCOM_DOWNLOAD_MODE=n
CONFIG_POWER_RESET_QCOM_DOWNLOAD_MODE_DEFAULT=y
CONFIG_POWER_RESET_QCOM_PON=n
CONFIG_POWER_RESET_QCOM_REBOOT_REASON=n
CONFIG_PWM_QTI_LPG=n
CONFIG_QCOM_ADSP_SLEEPMON=n
CONFIG_QCOM_AOSS_QMP=n
CONFIG_QCOM_BALANCE_ANON_FILE_RECLAIM=y
CONFIG_QCOM_BAM_DMA=n
CONFIG_QCOM_BWMON=n
CONFIG_QCOM_CDSP_RM=n
CONFIG_QCOM_CLK_RPMH=n
# CONFIG_QCOM_COINCELL is not set
CONFIG_QCOM_COMMAND_DB=n
CONFIG_QCOM_CPUCP=n
CONFIG_QCOM_CPUSS_SLEEP_STATS=n
CONFIG_QCOM_CPU_VENDOR_HOOKS=n
CONFIG_QCOM_CRM=n
CONFIG_QCOM_DCC_V2=n
CONFIG_QCOM_DCVS=n
CONFIG_QCOM_DCVS_FP=n
CONFIG_QCOM_DEBUG_SYMBOL=n
CONFIG_QCOM_DMABUF_HEAPS=n
CONFIG_QCOM_DMABUF_HEAPS_CARVEOUT=y
CONFIG_QCOM_DMABUF_HEAPS_CMA=y
CONFIG_QCOM_DMABUF_HEAPS_PAGE_POOL_REFILL=y
CONFIG_QCOM_DMABUF_HEAPS_SYSTEM=y
CONFIG_QCOM_DMABUF_HEAPS_SYSTEM_SECURE=y
CONFIG_QCOM_DMABUF_HEAPS_UBWCP=y
# CONFIG_QCOM_DYN_MINIDUMP_STACK is not set
CONFIG_QCOM_EUD=n
CONFIG_QCOM_FORCE_WDOG_BITE_ON_PANIC=y
CONFIG_QCOM_GDSC_REGULATOR=n
CONFIG_QCOM_GLINK=n
CONFIG_QCOM_GLINK_PKT=n
CONFIG_QCOM_HUNG_TASK_ENH=n
CONFIG_QCOM_IOMMU_DEBUG=n
CONFIG_QCOM_IOMMU_UTIL=n
# CONFIG_QCOM_IPA is not set
CONFIG_QCOM_IPCC=n
CONFIG_QCOM_LAZY_MAPPING=n
CONFIG_QCOM_LLCC=n
CONFIG_QCOM_LLCC_PERFMON=n
CONFIG_QCOM_LLCC_PMU=n
CONFIG_QCOM_LOGBUF_BOOTLOG=n
CONFIG_QCOM_LOGBUF_VENDOR_HOOKS=n
CONFIG_QCOM_MDT_LOADER=n
CONFIG_QCOM_MEMLAT=n
CONFIG_QCOM_MEMORY_DUMP_V2=n
CONFIG_QCOM_MEM_BUF=n
CONFIG_QCOM_MEM_BUF_DEV=n
CONFIG_QCOM_MEM_BUF_DEV_GH=y
CONFIG_QCOM_MEM_BUF_GH=y
CONFIG_QCOM_MEM_BUF_MSGQ=n
CONFIG_QCOM_MEM_HOOKS=n
CONFIG_QCOM_MEM_OFFLINE=n
CONFIG_QCOM_MINIDUMP=n
CONFIG_QCOM_MINIDUMP_FTRACE=y
CONFIG_QCOM_MINIDUMP_PANIC_CPU_CONTEXT=y
CONFIG_QCOM_MINIDUMP_PANIC_DUMP=y
CONFIG_QCOM_MINIDUMP_PANIC_MEMORY_INFO=y
CONFIG_QCOM_MINIDUMP_PSTORE=y
CONFIG_QCOM_PANEL_EVENT_NOTIFIER=n
CONFIG_QCOM_PANIC_ON_NOTIF_TIMEOUT=y
CONFIG_QCOM_PANIC_ON_PDR_NOTIF_TIMEOUT=y
CONFIG_QCOM_PCIE_PDC=n
CONFIG_QCOM_PDC=n
CONFIG_QCOM_PDR_HELPERS=n
CONFIG_QCOM_PIL_INFO=n
CONFIG_QCOM_PMU_LIB=n
# CONFIG_QCOM_Q6V5_ADSP is not set
CONFIG_QCOM_Q6V5_COMMON=n
# CONFIG_QCOM_Q6V5_MSS is not set
CONFIG_QCOM_Q6V5_PAS=n
# CONFIG_QCOM_Q6V5_WCSS is not set
CONFIG_QCOM_QFPROM_SYS=n
CONFIG_QCOM_QMI_HELPERS=n
CONFIG_QCOM_RAMDUMP=n
CONFIG_QCOM_RPMH=n
CONFIG_QCOM_RPROC_BOTH_DUMPS=y
CONFIG_QCOM_RPROC_COMMON=n
# CONFIG_QCOM_RUN_QUEUE_STATS is not set
CONFIG_QCOM_SCM=n
# CONFIG_QCOM_SCM_DOWNLOAD_MODE_DEFAULT is not set
CONFIG_QCOM_SECURE_BUFFER=n
CONFIG_QCOM_SHOW_RESUME_IRQ=n
CONFIG_QCOM_SMEM=n
CONFIG_QCOM_SMP2P=n
CONFIG_QCOM_SMP2P_SLEEPSTATE=n
# CONFIG_QCOM_SMSM is not set
CONFIG_QCOM_SOCINFO=n
# CONFIG_QCOM_SOC_WATCHDOG is not set
CONFIG_QCOM_SPMI_ADC5_GEN3=n
CONFIG_QCOM_SPMI_TEMP_ALARM=n
CONFIG_QCOM_SPSS=n
CONFIG_QCOM_STATS=n
CONFIG_QCOM_SYSMON=n
CONFIG_QCOM_SYSMON_SUBSYSTEM_STATS=n
CONFIG_QCOM_TSENS=n
CONFIG_QCOM_VADC_COMMON=n
CONFIG_QCOM_VA_MINIDUMP=n
CONFIG_QCOM_VM_DMESG_DUMPER=n
CONFIG_QCOM_WATCHDOG_BARK_TIME=11000
CONFIG_QCOM_WATCHDOG_IPI_PING=y
CONFIG_QCOM_WATCHDOG_PET_TIME=9360
# CONFIG_QCOM_WATCHDOG_USERSPACE_PET is not set
CONFIG_QCOM_WATCHDOG_WAKEUP_ENABLE=y
# CONFIG_QCOM_WCNSS_PIL is not set
# CONFIG_QCOM_WDOG_BITE_EARLY_PANIC is not set
CONFIG_QCOM_WDT_CORE=n
CONFIG_QRTR=n
CONFIG_QRTR_GUNYAH=n
CONFIG_QRTR_MHI=n
CONFIG_QRTR_SMD=n
CONFIG_QSEECOM_PROXY=n
CONFIG_QSEE_IPC_IRQ_BRIDGE=n
CONFIG_QTI_ALTMODE_GLINK=n
CONFIG_QTI_BATTERY_CHARGER=n
CONFIG_QTI_BATTERY_GLINK_DEBUG=n
CONFIG_QTI_BCL_PMIC5=n
CONFIG_QTI_BCL_SOC_DRIVER=n
CONFIG_QTI_C1DCVS_SCMI_V2=n
CONFIG_QTI_CHARGER_ULOG_GLINK=n
CONFIG_QTI_CPUCP_LOG=n
CONFIG_QTI_CPUFREQ_CDEV=n
CONFIG_QTI_CPUFREQ_STATS_SCMI_V2=n
CONFIG_QTI_CPU_HOTPLUG_COOLING_DEVICE=n
CONFIG_QTI_CPU_PAUSE_COOLING_DEVICE=n
CONFIG_QTI_CPU_VOLTAGE_COOLING_DEVICE=n
CONFIG_QTI_CRYPTO_COMMON=n
# CONFIG_QTI_CRYPTO_TZ is not set
CONFIG_QTI_DDR_COOLING_DEVICE=n
CONFIG_QTI_DEVFREQ_CDEV=n
CONFIG_QTI_DYNPF_SCMI=n
CONFIG_QTI_GLINK_ADC=n
CONFIG_QTI_GPU_DUMP_SKIP_COOLING_DEVICE=n
CONFIG_QTI_HW_KEY_MANAGER=n
CONFIG_QTI_IOMMU_SUPPORT=n
CONFIG_QTI_MPAM=n
CONFIG_QTI_PMIC_EUSB2_REPEATER=n
CONFIG_QTI_PMIC_GLINK=n
# CONFIG_QTI_PMIC_GLINK_CLIENT_DEBUG is not set
CONFIG_QTI_PMIC_GLINK_DEBUG=n
CONFIG_QTI_PMIC_PON_LOG=n
CONFIG_QTI_QCOM_SCMI_CLIENT=n
CONFIG_QTI_QMI_COOLING_DEVICE=n
CONFIG_QTI_QMI_SENSOR_V2=n
CONFIG_QTI_SCMI_VENDOR_PROTOCOL=n
CONFIG_QTI_SYS_PM_VX=n
CONFIG_QTI_THERMAL_LIMITS_DCVS=n
CONFIG_QTI_THERMAL_MINIDUMP=n
CONFIG_QTI_USERSPACE_CDEV=n
CONFIG_REBOOT_MODE=n
CONFIG_REGMAP_QTI_DEBUGFS=n
# CONFIG_REGMAP_QTI_DEBUGFS_ALLOW_WRITE is not set
CONFIG_REGULATOR_DEBUG_CONTROL=n
CONFIG_REGULATOR_PROXY_CONSUMER=n
# CONFIG_REGULATOR_PROXY_CONSUMER_LEGACY is not set
CONFIG_REGULATOR_QCOM_PM8008=n
CONFIG_REGULATOR_QPNP_AMOLED=n
CONFIG_REGULATOR_QPNP_LCDB=n
CONFIG_REGULATOR_QTI_FIXED_VOLTAGE=n
CONFIG_REGULATOR_QTI_OCP_NOTIFIER=n
CONFIG_REGULATOR_RPMH=n
CONFIG_REGULATOR_STUB=n
CONFIG_RPMSG_QCOM_GLINK=n
CONFIG_RPMSG_QCOM_GLINK_SMEM=n
CONFIG_RPMSG_QCOM_GLINK_SPSS=n
CONFIG_RPMSG_QCOM_SMD=n
CONFIG_RPROC_SSR_NOTIF_TIMEOUT=20000
CONFIG_RPROC_SYSMON_NOTIF_TIMEOUT=20000
CONFIG_RTC_DRV_PM8XXX=n
CONFIG_SCHED_WALT=n
# CONFIG_SCHED_WALT_DEBUG is not set
CONFIG_SCSI_UFS_CRYPTO_QTI=n
CONFIG_SCSI_UFS_QCOM=n
CONFIG_SENSORS_QTI_AMOLED_ECM=n
CONFIG_SERIAL_MSM_GENI=n
CONFIG_SHOW_SUSPEND_EPOCH=n
CONFIG_SLIMBUS=n
CONFIG_SLIM_QCOM_NGD_CTRL=n
CONFIG_SM_CAMCC_CLIFFS=n
CONFIG_SM_CAMCC_PINEAPPLE=n
CONFIG_SM_CAMCC_VOLCANO=n
CONFIG_SM_DEBUGCC_CLIFFS=n
CONFIG_SM_DEBUGCC_PINEAPPLE=n
CONFIG_SM_DEBUGCC_VOLCANO=n
CONFIG_SM_DISPCC_PINEAPPLE=n
CONFIG_SM_DISPCC_VOLCANO=n
CONFIG_SM_GCC_CLIFFS=n
CONFIG_SM_GCC_PINEAPPLE=n
CONFIG_SM_GCC_VOLCANO=n
CONFIG_SM_GPUCC_CLIFFS=n
CONFIG_SM_GPUCC_PINEAPPLE=n
CONFIG_SM_GPUCC_VOLCANO=n
CONFIG_SM_TCSRCC_PINEAPPLE=n
CONFIG_SM_VIDEOCC_PINEAPPLE=n
CONFIG_SM_VIDEOCC_VOLCANO=n
CONFIG_SND_USB_AUDIO_QMI=n
CONFIG_SPI_MSM_GENI=n
CONFIG_SPMI_MSM_PMIC_ARB=n
CONFIG_SPMI_MSM_PMIC_ARB_DEBUG=n
CONFIG_SPS=n
CONFIG_SPS_SUPPORT_NDP_BAM=y
CONFIG_STM=n
CONFIG_STM_PROTO_OST=n
CONFIG_STM_SOURCE_CONSOLE=n
CONFIG_STM_SOURCE_FTRACE=n
CONFIG_STM_SOURCE_HEARTBEAT=n
CONFIG_TOUCHSCREEN_NT36XXX_SPI=n
CONFIG_DRM_PANEL=y
CONFIG_UCSI_QTI_GLINK=n
CONFIG_UIO_MSM_SHAREDMEM=n
CONFIG_USB_CONFIGFS_F_CCID=n
CONFIG_USB_CONFIGFS_F_CDEV=n
CONFIG_USB_CONFIGFS_F_GSI=n
CONFIG_USB_CONFIGFS_F_QDSS=n
CONFIG_USB_DWC3_MSM=n
CONFIG_USB_F_CCID=n
CONFIG_USB_F_CDEV=n
CONFIG_USB_F_FS_IPC_LOGGING=n
CONFIG_USB_F_GSI=n
CONFIG_USB_F_QDSS=n
CONFIG_USB_MSM_EUSB2_PHY=n
CONFIG_USB_MSM_SSPHY_QMP=n
CONFIG_USB_QCOM_EMU_PHY=n
CONFIG_USB_REDRIVER=n
CONFIG_USB_REDRIVER_NB7VPQ904M=n
CONFIG_USB_REPEATER=n
CONFIG_USB_CONFIGFS_RNDIS=n
CONFIG_USB_F_RNDIS=n
CONFIG_USB_NET_SMSC95XX=n
#Lapis code by sunyt13 at 2024-4-16 for fp bringup start
CONFIG_GOODIX_FINGERPRINT=n
CONFIG_INPUT_FINGERPRINT=n
#Lapis code by sunyt13 at 2024-4-16 for fp bringup end
# CONFIG_VIDEO_QCOM_VENUS is not set
CONFIG_HQ_SYSFS_SUPPORT=n
CONFIG_AW3750X_POWER=n
CONFIG_LENOVO_KEYBOARD=n
CONFIG_LENOVO_BL_BOOSTER=n
CONFIG_LENOVO_THERMAL_CONTROL=n
CONFIG_LENOVO_SYS_TEMP=n
```

## kernel/lenovo/kirby/kernel/drivers/misc/hqsysfs/Kconfig
```kconfig
config HQ_SYSFS_SUPPORT
  tristate "Enable Huaqin Sysfs Driver"
  default m
  help
    Huaqin Sysfs information driver includes specific information about hardware info and other info for HQ tools
```
